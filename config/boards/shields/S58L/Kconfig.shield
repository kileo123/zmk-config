## config/boards/shields/S58L/Kconfig.shield
```kconfig
# Copyright (c) 2022 The ZMK Contributors
# SPDX-License-Identifier: MIT

config SHIELD_S58L
    def_bool $(shields_list_contains,S58L)
```

## config/boards/shields/S58R/Kconfig.shield
```kconfig
# Copyright (c) 2022 The ZMK Contributors
# SPDX-License-Identifier: MIT

config SHIELD_S58R
    def_bool $(shields_list_contains,S58R)
```

## config/boards/shields/Suzaku58/Kconfig.shield
```kconfig
# Copyright (c) 2022 The ZMK Contributors
# SPDX-License-Identifier: MIT

config SHIELD_SUZAKU58_LEFT
    def_bool $(shields_list_contains,Suzaku58_left)

config SHIELD_SUZAKU58_RIGHT
    def_bool $(shields_list_contains,Suzaku58_right)
```

## config/boards/shields/three_percent_milk/Kconfig.defconfig
```kconfig
# Copyright (c) 2022 The ZMK Contributors
# SPDX-License-Identifier: MIT

if SHIELD_THREE_PERCENT_MILK

config ZMK_KEYBOARD_NAME
    default "3% Milk"

endif
```

## config/boards/shields/three_percent_milk/Kconfig.shield
```kconfig
# Copyright (c) 2022 The ZMK Contributors
# SPDX-License-Identifier: MIT

config SHIELD_THREE_PERCENT_MILK
	def_bool $(shields_list_contains,three_percent_milk)
```
